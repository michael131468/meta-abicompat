## conf/layer.conf
```bitbake
# We have a conf and classes directory, add to BBPATH
BBPATH .= ":${LAYERDIR}"

# We have recipes-* directories, add to BBFILES
BBFILES += "${LAYERDIR}/recipes-*/*/*.bb \
            ${LAYERDIR}/recipes-*/*/*.bbappend"

BBFILE_COLLECTIONS += "meta-abicompat"
BBFILE_PATTERN_meta-abicompat = "^${LAYERDIR}/"
BBFILE_PRIORITY_meta-abicompat = "6"

LAYERDEPENDS_meta-abicompat = "core"
LAYERSERIES_COMPAT_meta-abicompat = "gatesgarth"

# We can't use BASE_DEFAULT_DEPS because INHIBIT_DEFAULT_DEPS wipes us out of the variable
BASEDEPENDS_class-target_append += "abidw-native"
BASEDEPENDS_class-nativesdk_append += "abidw-native"

# Inject our own sstate hash equiv function for generating hashes
SSTATE_HASHEQUIV_METHOD = "abicompat.sstatesig.ABICompatBasicHash"

# Inject our bbclass into all recipes to provide variables that our hashequiv checker needs
INHERIT += "abicompat"

# Control version of alpaca recipe conveniently here
PREFERRED_VERSION_alpaca = "1.0.0"
#PREFERRED_VERSION_alpaca = "1.0.1"
#PREFERRED_VERSION_alpaca = "1.0.2"
#PREFERRED_VERSION_alpaca = "1.0.3"
#PREFERRED_VERSION_alpaca = "1.1.0"
#PREFERRED_VERSION_alpaca = "2.0.0"

# Control version of bandicoot recipe conveniently here
PREFERRED_VERSION_bandicoot = "1.0.0"
#PREFERRED_VERSION_bandicoot = "1.0.1"
```
